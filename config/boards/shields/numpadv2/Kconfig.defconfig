## config/boards/shields/numpadv2/Kconfig.defconfig
```kconfig
if SHIELD_NUMPADV2

config ZMK_KEYBOARD_NAME
    default "numpadv2"

if ZMK_DISPLAY

config I2C
	default y

config SSD1306
	default y

config SSD1306_REVERSE_MODE
	default y

endif # ZMK_DISPLAY

if LVGL

config LVGL_VDB_SIZE
	default 32

config LVGL_DPI
	default 128

config LVGL_BITS_PER_PIXEL
	default 1

choice LVGL_COLOR_DEPTH
	default LVGL_COLOR_DEPTH_1
endchoice

choice LV_HOR_RES_MAX
    default 32
endchoice

choice LV_VER_RES_MAX
    default 128
endchoice

endif # LVGL

endif
```
